/******************************************************************************/
/*  Name:  LCD12864(St7920/St7921)+超声波测距模块+STC89C52                    */
/*  HC-SR04 超声波测距模块 DEMO 程序									      */
/*  晶振：11.0592M                                                            */
/*  接线：模块TRIG接 P1.2  ECH0 接P1.1										  */
/*      RS(CS)    接  P3.3;	 											      */
/*      RW(SID)   接  P3.4;										              */
/*      E(SCLK)   接  P3.5;											          */
/*      PSB       接  GND 串行模式										      */
/******************************************************************************/
    #include   <AT89X51.H>
	#include   <intrins.h>	
//引脚定义
    sbit     RX    =  P1 ^ 1;
    sbit     TX    =  P1 ^ 2;
    sbit     CS    =  P3 ^ 3;	//片选 高电平有效 单片LCD使用时可固定高电平
    sbit     SID   =  P3 ^ 4;	//数据
    sbit     SCLK  =  P3 ^ 5;	//时钟

//Function Definition　函数声明 
void Delay(int num);
void Init_DS18B20(void);
unsigned char ReadOneChar(void);
void WriteOneChar(unsigned char dat);
unsigned int ReadTemperature(void);
void clock_out(unsigned char dd);
unsigned char clock_in(void);
unsigned char read_clock(unsigned char ord);
void write_clock(unsigned char ord, unsigned char dd);
void Disp(void);
void id_case1_key(void);
void id_case2_key(void);
void Set_time(unsigned char sel,bit sel_1);
void Timer0_Init(void);
void Init_1302(void);
void Set_Bell(unsigned char sel, bit sel_1);
void Bell(void);
//12864
void Write_char(bit start, unsigned char ddata);
void Send_byte(unsigned char bbyte);
void Delaynms(unsigned int di);
void Lcd_init(void);
void Disp_img(unsigned char *img);
void LCD_Write_string(unsigned char X,unsigned char Y,unsigned char *s);
void LCD_set_xy( unsigned char x, unsigned char y );
unsigned char code num[]={"0123456789 :.-"};
unsigned char code waves[]={"超声波测距系统"};
unsigned char code znwk[] ={"智能微控工作室"};
unsigned char code CM[] =  {"M"};
unsigned int  time=0;
         long S=0;
         bit  flag =0;
unsigned char disbuff[4]	   ={ 0,0,0,0,};
unsigned char code logo[]={  
/*--  调入了一幅图像：logo.bmp  -- */ 
/*--  宽度x高度=128x64 欢迎使用本产品LOGO --*/
/*--  调入了一幅图像：C:\Documents and Settings\lwd\桌面\新建文件夹\X.bmp  --*/
/*--  宽度x高度=128x64  --*/
0x00,0x00,0x00,0x00,0x00,0x00,0x00,0x00,0x00,0x00,0x00,0x00,0x00,0x00,0x00,0x00,
0x00,0x00,0x00,0x00,0x00,0x00,0x00,0x00,0x00,0x00,0x00,0x00,0x00,0x00,0x00,0x00,
0x00,0x00,0x00,0x00,0x00,0x00,0x00,0x00,0x00,0x00,0x00,0x00,0x00,0x00,0x00,0x00,
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0x00,0x00,0x00,0x00,0x00,0x00,0x00,0x00,0x00,0x00,0x00,0x00,0x00,0x00,0x00,0x00,
};

/******************************************************************************/
void Lcd_init(void)	//初始化LCD 
{
	Delaynms(10); //启动等待，等LCM讲入工作状态
  	CS=1;
  	Write_char(0,0x30);  //8 位介面，基本指令集
  	Write_char(0,0x0c);  //显示打开，光标关，反白关
  	Write_char(0,0x01);  //清屏，将DDRAM的地址计数器归零  
}

/******************************************************************************/
void Write_char(bit start, unsigned char ddata) //写指令或数据
{
	unsigned char start_data,Hdata,Ldata;
  	if(start==0) 
		start_data=0xf8;	 //写指令
    else    
    	start_data=0xfa;  //写数据
  
  	Hdata=ddata&0xf0;		  //取高四位
  	Ldata=(ddata<<4)&0xf0;  //取低四位
  	Send_byte(start_data);	  //发送起始信号
  	Delaynms(5); //延时是必须的
  	Send_byte(Hdata);	      //发送高四位
  	Delaynms(1);  //延时是必须的
  	Send_byte(Ldata);		  //发送低四位
  	Delaynms(1);  //延时是必须的
}

/******************************************************************************/
void Send_byte(unsigned char bbyte) //发送一个字节
{
	unsigned char i;
 	for(i=0;i<8;i++)
   	{
   		SID=bbyte&0x80; //取出最高位
 		SCLK=1;
   		SCLK=0;
   		bbyte<<=1; //左移
   	}  
}

/******************************************************************************/
void Delaynms(unsigned int di) //延时
{
	unsigned int da,db;
 	for(da=0;da<di;da++)
   		for(db=0;db<10;db++);
}

/******************************************************************************/
void Disp_img(unsigned char  *img)	//图形方式12864显示字模221 横向取膜
{ 
	unsigned char i,j;
	unsigned int k = 0;

	Write_char(0,0x36); //图形方式
	for(i=0;i<32;i++)
  	{ 
		Write_char(0,0x80+i);
		Write_char(0,0x80);
    	for(j=0;j<16;j++) 
		{
			Write_char(1,img[k++]);
		}
  	}

 	for(i=0;i<32;i++)
  	{ 
		Write_char(0,0x80+i);
		Write_char(0,0x88);
    	for(j=0;j<16;j++) 
		{
			Write_char(1,img[k++]);
  		}
	}
}
	
/******************************************************************************/
void Clr_Scr(void)//清屏函数
{
	Write_char(0,0x01);
}

/******************************************************************************/
void LCD_set_xy( unsigned char x, unsigned char y )
{	//设置LCD显示的起始位置，X为行，Y为列
    unsigned char address;
	switch(x)
	{
		case 0: address = 0x80 + y; break;    
    	case 1: address = 0x80 + y; break; 
		case 2: address = 0x90 + y; break; 
   	 	case 3: address = 0x88 + y; break;
		case 4: address = 0x98 + y; break; 
		default:address = 0x80 + y; break;
	}
    Write_char(0, address);
}

/******************************************************************************/
void LCD_Write_string(unsigned char X,unsigned char Y,unsigned char *s)
{	//	中英文字符串显示函数
	LCD_set_xy( X, Y );
    
    while (*s) 
    {
		Write_char( 1, *s );
	    s ++;
		Delaynms(1);
	}
}

/******************************************************************************/
void LCD_Write_number(unsigned char s)//	数字显示函数
{	
	Write_char(1,num[s]);
	Delaynms(1);
}
/******************************************************************************/
void Lcd_Mark2(void)
{
	Clr_Scr();//清屏
	LCD_Write_string(1,0,znwk);//
	LCD_Write_string(2,0,waves);//	
	LCD_Write_string(3,7,CM);//	
}

/********************************************************/
    void Conut(void)
	{
	   time=TH0*256+TL0;
	   TH0=0;
	   TL0=0;
	   S=time*1.87/100;       //算出来是CM	  11。0592M晶振
	   if(flag==1)		      //超出测量
	  {	 
	   flag=0;
	   LCD_set_xy( 3, 4 );
	   LCD_Write_number(13);
	   LCD_Write_number(12);
	   LCD_set_xy( 3, 5 );
	   LCD_Write_number(13);
	   LCD_Write_number(13);
	  
	   }
	 else
	  {
	   disbuff[1]=S%1000/100;
	   disbuff[2]=S%1000%100/10;
	   disbuff[3]=S%1000%10 %10;
	   LCD_set_xy( 3, 4 );
	   LCD_Write_number(disbuff[1]);
	   LCD_Write_number(12);
	   LCD_set_xy( 3, 5 );
	   LCD_Write_number(disbuff[2]);
	   LCD_Write_number(disbuff[3]);
	  }
	}
/********************************************************/ 
void delayms(unsigned int ms)
{
	unsigned char i=100,j;
	for(;ms;ms--)
	{
		while(--i)
		{
			j=10;
			while(--j);
		}
	}
}
/********************************************************/
     void zd0() interrupt 1 		 //T0中断用来计数器溢出,超过测距范围
  {
    flag=1;							 //中断溢出标志
  }
/********************************************************/
   void  StartModule() 		         //T1中断用来扫描数码管和计800MS启动模块
  {
	  TX=1;			                 //800MS  启动一次模块
	  _nop_(); 
	  _nop_(); 
	  _nop_(); 
	  _nop_(); 
	  _nop_(); 
	  _nop_(); 
	  _nop_(); 
	  _nop_(); 
	  _nop_(); 
	  _nop_(); 
	  _nop_(); 
	  _nop_(); 
	  _nop_(); 
	  _nop_(); 
	  _nop_(); 
	  _nop_(); 
	  _nop_();
	  _nop_(); 
	  _nop_(); 
	  _nop_(); 
	  _nop_();
	  TX=0;
  }
/********************************************************/
void main(void)
{  
    TMOD=0x01;		   //设T0为方式1，GATE=1
	TH0=0;
	TL0=0; 
	TR0=1; 

	Lcd_init();       //设置液晶显示器
	Clr_Scr();        //清屏	
	Disp_img(logo);	  //显示欢迎使用本产品LOGO
	Delaynms(1000);
	Lcd_init();       //从图形显示状态下返回
    Lcd_Mark2();


	while(1)
	{
	 StartModule();	 
	 		        	//计算
	 while(!RX);		//当RX为零时等待
	 TR0=1;			    //开启计数
	 while(RX);			//当RX为1计数并等待
	 TR0=0;				//关闭计数
	 Conut();
	 delayms(80);		//80MS

	}

}              